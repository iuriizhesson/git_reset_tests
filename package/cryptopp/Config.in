## package/cryptopp/Config.in
```kconfig
config BR2_PACKAGE_CRYPTOPP
	bool "cryptopp"
	help
	  Crypto++ Library is a free C++ class library of cryptographic schemes.

	  http://www.cryptopp.com

comment "cryptopp needs a toolchain w/ C++"
	depends on !BR2_INSTALL_LIBSTDCPP
```

## package/microsoft-bond/Config.in
```kconfig
config BR2_PACKAGE_MICROSOFT_BOND
	bool "microsoft-bond"
	select BR2_PACKAGE_BOOST_THREAD
	select BR2_PACKAGE_RAPIDJSON
	select BR2_PACKAGE_HOST_PATCHELF
	help
	  https://github.com/Microsoft/bond
```
